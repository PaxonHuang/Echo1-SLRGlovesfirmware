## esp-idf-handsignal/sdkconfig.defaults
```kconfig
# Serial flasher config
CONFIG_ESPTOOLPY_FLASHSIZE_4MB=y
CONFIG_ESPTOOLPY_FLASHMODE_DIO=y
CONFIG_ESPTOOLPY_FLASHFREQ_40M=y

# Bootloader config
CONFIG_BOOTLOADER_LOG_LEVEL_INFO=y

# Log output
CONFIG_LOG_DEFAULT_LEVEL_INFO=y
CONFIG_LOG_MAXIMUM_LEVEL_DEBUG=y

# FreeRTOS
CONFIG_FREERTOS_HZ=1000
CONFIG_FREERTOS_WATCHPOINT_END_OF_STACK=y

# Main task stack size
CONFIG_ESP_MAIN_TASK_STACK_SIZE=8192

# ADC Configuration
CONFIG_ADC_CAL_EFUSE_TP_ENABLE=y
CONFIG_ADC_CAL_EFUSE_VREF_ENABLE=y
CONFIG_ADC_CAL_LUT_ENABLE=y

# I2C Configuration
CONFIG_I2C_ENABLE_DEBUG_LOG=y

# UART Configuration
CONFIG_UART_ISR_IN_IRAM=y
```
